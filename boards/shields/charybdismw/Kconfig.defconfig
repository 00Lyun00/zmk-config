## boards/shields/charybdismw/Kconfig.defconfig
```kconfig
if SHIELD_CHARYBDISMW_RIGHT

config ZMK_KEYBOARD_NAME
    default "Charybdis MW"

config ZMK_SPLIT_ROLE_CENTRAL
    default y

endif

if SHIELD_CHARYBDISMW_LEFT || SHIELD_CHARYBDISMW_RIGHT

config ZMK_SPLIT
    default y

endif
```

## boards/shields/charybdismw/Kconfig.shield
```kconfig
config SHIELD_CHARYBDISMW_LEFT
    def_bool $(shields_list_contains,charybdismw_left)

config SHIELD_CHARYBDISMW_RIGHT
    def_bool $(shields_list_contains,charybdismw_right)
```

## config/west.yml
```yaml
manifest:
  defaults:
    revision: v0.3
  remotes:
    - name: zmkfirmware
      url-base: https://github.com/zmkfirmware
    # Additional modules containing boards/shields/custom code can be listed here as well
    # See https://docs.zephyrproject.org/3.2.0/develop/west/manifest.html#projects
  projects:
    - name: zmk
      remote: zmkfirmware
      import: app/west.yml
    - name: zmk-keyboard--charybdisMW-
      url: https://github.com/00Lyun00/zmk-keyboard--charybdisMW-.git
      revision: main
      path: modules/zmk-keyboard--charybdisMW-
  self:
    path: config
```
