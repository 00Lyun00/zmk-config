// This file was generated from a template. Edit it to match your keyboard.
// See https://zmk.dev/docs/development/hardware-integration/new-shield for more
// instructions.

#include "charybdismw-layouts.dtsi"

/ {
    chosen {
        zmk,default-layout = &default_layout;
    };

    kscan: kscan {
        compatible = "zmk,kscan-gpio-matrix";
        diode-direction = "row2col";
        wakeup-source;

        row-gpios
			= <&pro_micro 18 GPIO_ACTIVE_HIGH>
			, <&pro_micro 14 GPIO_ACTIVE_HIGH>
			, <&pro_micro 16 GPIO_ACTIVE_HIGH>
			, <&pro_micro 9 GPIO_ACTIVE_HIGH>
            ;
    };
};
